## examples/1200PT/sdkconfig.defaults
```kconfig
# Espressif IoT Development Framework Configuration
# Generated fresh for ESP32 Dev Module with PlatformIO

# Bootloader
CONFIG_BOOTLOADER_COMPILER_OPTIMIZATION_DEBUG=y
CONFIG_BOOTLOADER_LOG_LEVEL_INFO=y

# Core
CONFIG_ESP_SYSTEM_PANIC_PRINT_HALT=y
CONFIG_ESP_BROWNOUT_USE_INTR=y

# Serial
CONFIG_CONSOLE_UART_NUM=0
CONFIG_CONSOLE_UART_BAUDRATE=115200
CONFIG_CONSOLE_UART_TX_GPIO=1
CONFIG_CONSOLE_UART_RX_GPIO=3

# IRAM
CONFIG_ESP_SYSTEM_ALLOW_RTC_FAST_MEM_AS_HEAP=y

# Newlib / LIBC
CONFIG_LIBC_STDOUT_LINE_ENDING_LF=y
CONFIG_LIBC_STDIN_LINE_ENDING_LF=y

# FreeRTOS
CONFIG_FREERTOS_UNICORE=y
CONFIG_FREERTOS_USE_TRACE_FACILITY=y
CONFIG_FREERTOS_GENERATE_RUN_TIME_STATS=y

# ADC
CONFIG_ADC_CALI_EFUSE_TP_ENABLE=y
CONFIG_ADC_CALI_EFUSE_VREF_ENABLE=y
CONFIG_ADC_CALI_LUT_ENABLE=y

# Timer
CONFIG_GPTIMER_ISR_CACHE_SAFE=y
CONFIG_MCPWM_ISR_CACHE_SAFE=y

# Logging
CONFIG_LOG_DEFAULT_LEVEL_INFO=y

# Memory
CONFIG_SPIRAM_IGNORE_NOTFOUND=y

# Flash size - match board_build.flash_size = 2MB
CONFIG_ESPTOOLPY_FLASHSIZE_2MB=y
```
